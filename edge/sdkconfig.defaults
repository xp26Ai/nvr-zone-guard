## edge/sdkconfig.defaults
```kconfig
# Target config
CONFIG_IDF_TARGET="esp32s3"

# ESP32-S3 PSRAM Configuration
CONFIG_ESP32S3_SPIRAM_SUPPORT=y
CONFIG_SPIRAM_MODE_OCT=y
CONFIG_SPIRAM_SPEED_80M=y
CONFIG_SPIRAM_TYPE_AUTO=y
CONFIG_SPIRAM_ALLOW_BSS_SEG_EXTERNAL_MEMORY=y

# TLS and HTTPS Certificate configurations
CONFIG_MBEDTLS_HAVE_TIME=y
CONFIG_MBEDTLS_KEY_EXCHANGE_ECJPAKE_ENABLED=y
CONFIG_MBEDTLS_CERTIFICATE_BUNDLE=y
CONFIG_MBEDTLS_CERTIFICATE_BUNDLE_DEFAULT_FULL=y

# Stack sizes
CONFIG_ESP_MAIN_TASK_STACK_SIZE=16384

# Increase Task Watchdog Timeout for Heavy Inference Models
CONFIG_ESP_TASK_WDT_TIMEOUT_S=15
```
